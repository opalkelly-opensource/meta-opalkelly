## conf/layer.conf
```bitbake
# We have a conf and classes directory, add to BBPATH
BBPATH .= ":${LAYERDIR}"

# We have a recipes-* directories, add to BBFILES
BBFILES += "${LAYERDIR}/recipes-*/*/*.bb \
	${LAYERDIR}/recipes-*/*/*.bbappend"

BBFILE_COLLECTIONS += "opalkelly"
BBFILE_PATTERN_opalkelly = "^${LAYERDIR}/"
BBFILE_PRIORITY_opalkelly = "6"

LAYERDEPENDS_opalkelly = "xilinx"
```

## conf/machine/syzygy-hub.conf
```bitbake
#@TYPE: Machine
#@NAME: syzygy-hub

#@DESCRIPTION: Machine configuration for syzygy-hub systems

KERNEL_IMAGETYPE = "fitImage"

require conf/machine/include/tune-zynq.inc
require conf/machine/include/machine-xilinx-default.inc
require conf/machine/include/machine-xilinx-board.inc

PREFERRED_PROVIDER_virtual/bootloader = "u-boot"
PREFERRED_VERSION_u-boot = "2018.01"

EXTRA_IMAGEDEPENDS += "virtual/bitstream"

SERIAL_CONSOLE = "115200 ttyPS0"

SPL_BINARY = "spl/boot.bin"
UBOOT_MACHINE = "syzygy_hub_config"
UBOOT_ENTRYPOINT = "0x8000"
UBOOT_LOADADDRESS = "0x8000"

KERNEL_DEVICETREE = "zynq-syzygy-hub.dtb"

MACHINE_FEATURES = "ext2 serial usbgadget usbhost vfat"

IMAGE_BOOT_FILES += "boot.bin download.bit fitImage u-boot.${UBOOT_SUFFIX} uEnv.txt"
```
